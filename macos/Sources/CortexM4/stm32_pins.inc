// Generated by tools/arm-reference/pinmap.py from STMicroelectronics' STM32_open_pin_data (the pin
// database STM32CubeMX uses): the bus signals each pin of the modelled packages carries, by alternate
// function (af) or, on the F103, by its remap (the AFIO_MAPR field at `remap_shift` holding `remap`).
//
// Copyright (c) 2020, STMicroelectronics. All rights reserved. Redistributed under the BSD 3-Clause
// License: redistribution and use in source and binary forms, with or without modification, are
// permitted provided that the copyright notice, this list of conditions and the following disclaimer
// are retained; neither the name of the copyright holder nor the names of its contributors may be used
// to endorse or promote products derived from this software without specific prior written permission.
// THIS SOFTWARE IS PROVIDED BY THE COPYRIGHT HOLDERS AND CONTRIBUTORS "AS IS" AND ANY EXPRESS OR
// IMPLIED WARRANTIES ARE DISCLAIMED.

    {STM32_F103, 0, 2, -1, 3, 0, PIN_USART, 2, ROLE_TX},
    {STM32_F103, 0, 3, -1, 3, 0, PIN_USART, 2, ROLE_RX},
    {STM32_F103, 0, 4, -1, 0, 0, PIN_SPI, 1, ROLE_NSS},
    {STM32_F103, 0, 5, -1, 0, 0, PIN_SPI, 1, ROLE_SCK},
    {STM32_F103, 0, 6, -1, 0, 0, PIN_SPI, 1, ROLE_MISO},
    {STM32_F103, 0, 7, -1, 0, 0, PIN_SPI, 1, ROLE_MOSI},
    {STM32_F103, 0, 9, -1, 2, 0, PIN_USART, 1, ROLE_TX},
    {STM32_F103, 0, 10, -1, 2, 0, PIN_USART, 1, ROLE_RX},
    {STM32_F103, 0, 15, -1, 0, 1, PIN_SPI, 1, ROLE_NSS},
    {STM32_F103, 1, 3, -1, 0, 1, PIN_SPI, 1, ROLE_SCK},
    {STM32_F103, 1, 4, -1, 0, 1, PIN_SPI, 1, ROLE_MISO},
    {STM32_F103, 1, 5, -1, 0, 1, PIN_SPI, 1, ROLE_MOSI},
    {STM32_F103, 1, 6, -1, 1, 0, PIN_I2C, 1, ROLE_SCL},
    {STM32_F103, 1, 6, -1, 2, 1, PIN_USART, 1, ROLE_TX},
    {STM32_F103, 1, 7, -1, 1, 0, PIN_I2C, 1, ROLE_SDA},
    {STM32_F103, 1, 7, -1, 2, 1, PIN_USART, 1, ROLE_RX},
    {STM32_F103, 1, 8, -1, 1, 1, PIN_I2C, 1, ROLE_SCL},
    {STM32_F103, 1, 9, -1, 1, 1, PIN_I2C, 1, ROLE_SDA},
    {STM32_F103, 1, 10, -1, -1, 0, PIN_I2C, 2, ROLE_SCL},
    {STM32_F103, 1, 10, -1, 4, 0, PIN_USART, 3, ROLE_TX},
    {STM32_F103, 1, 11, -1, -1, 0, PIN_I2C, 2, ROLE_SDA},
    {STM32_F103, 1, 11, -1, 4, 0, PIN_USART, 3, ROLE_RX},
    {STM32_F103, 1, 12, -1, -1, 0, PIN_SPI, 2, ROLE_NSS},
    {STM32_F103, 1, 13, -1, -1, 0, PIN_SPI, 2, ROLE_SCK},
    {STM32_F103, 1, 14, -1, -1, 0, PIN_SPI, 2, ROLE_MISO},
    {STM32_F103, 1, 15, -1, -1, 0, PIN_SPI, 2, ROLE_MOSI},
    {STM32_F373, 0, 1, 6, -1, 0, PIN_SPI, 3, ROLE_SCK},
    {STM32_F373, 0, 2, 6, -1, 0, PIN_SPI, 3, ROLE_MCK},
    {STM32_F373, 0, 2, 6, -1, 0, PIN_SPI, 3, ROLE_MISO},
    {STM32_F373, 0, 2, 7, -1, 0, PIN_USART, 2, ROLE_TX},
    {STM32_F373, 0, 3, 6, -1, 0, PIN_SPI, 3, ROLE_MOSI},
    {STM32_F373, 0, 3, 7, -1, 0, PIN_USART, 2, ROLE_RX},
    {STM32_F373, 0, 4, 5, -1, 0, PIN_SPI, 1, ROLE_NSS},
    {STM32_F373, 0, 4, 6, -1, 0, PIN_SPI, 3, ROLE_NSS},
    {STM32_F373, 0, 5, 5, -1, 0, PIN_SPI, 1, ROLE_SCK},
    {STM32_F373, 0, 6, 5, -1, 0, PIN_SPI, 1, ROLE_MCK},
    {STM32_F373, 0, 6, 5, -1, 0, PIN_SPI, 1, ROLE_MISO},
    {STM32_F373, 0, 7, 5, -1, 0, PIN_SPI, 1, ROLE_MOSI},
    {STM32_F373, 0, 8, 5, -1, 0, PIN_SPI, 2, ROLE_SCK},
    {STM32_F373, 0, 9, 4, -1, 0, PIN_I2C, 2, ROLE_SCL},
    {STM32_F373, 0, 9, 5, -1, 0, PIN_SPI, 2, ROLE_MCK},
    {STM32_F373, 0, 9, 5, -1, 0, PIN_SPI, 2, ROLE_MISO},
    {STM32_F373, 0, 9, 7, -1, 0, PIN_USART, 1, ROLE_TX},
    {STM32_F373, 0, 10, 4, -1, 0, PIN_I2C, 2, ROLE_SDA},
    {STM32_F373, 0, 10, 5, -1, 0, PIN_SPI, 2, ROLE_MOSI},
    {STM32_F373, 0, 10, 7, -1, 0, PIN_USART, 1, ROLE_RX},
    {STM32_F373, 0, 11, 6, -1, 0, PIN_SPI, 1, ROLE_NSS},
    {STM32_F373, 0, 11, 5, -1, 0, PIN_SPI, 2, ROLE_NSS},
    {STM32_F373, 0, 12, 6, -1, 0, PIN_SPI, 1, ROLE_SCK},
    {STM32_F373, 0, 13, 6, -1, 0, PIN_SPI, 1, ROLE_MCK},
    {STM32_F373, 0, 13, 6, -1, 0, PIN_SPI, 1, ROLE_MISO},
    {STM32_F373, 0, 14, 4, -1, 0, PIN_I2C, 1, ROLE_SDA},
    {STM32_F373, 0, 15, 4, -1, 0, PIN_I2C, 1, ROLE_SCL},
    {STM32_F373, 0, 15, 5, -1, 0, PIN_SPI, 1, ROLE_NSS},
    {STM32_F373, 0, 15, 6, -1, 0, PIN_SPI, 3, ROLE_NSS},
    {STM32_F373, 1, 0, 5, -1, 0, PIN_SPI, 1, ROLE_MOSI},
    {STM32_F373, 1, 3, 5, -1, 0, PIN_SPI, 1, ROLE_SCK},
    {STM32_F373, 1, 3, 6, -1, 0, PIN_SPI, 3, ROLE_SCK},
    {STM32_F373, 1, 3, 7, -1, 0, PIN_USART, 2, ROLE_TX},
    {STM32_F373, 1, 4, 5, -1, 0, PIN_SPI, 1, ROLE_MCK},
    {STM32_F373, 1, 4, 5, -1, 0, PIN_SPI, 1, ROLE_MISO},
    {STM32_F373, 1, 4, 6, -1, 0, PIN_SPI, 3, ROLE_MCK},
    {STM32_F373, 1, 4, 6, -1, 0, PIN_SPI, 3, ROLE_MISO},
    {STM32_F373, 1, 4, 7, -1, 0, PIN_USART, 2, ROLE_RX},
    {STM32_F373, 1, 5, 5, -1, 0, PIN_SPI, 1, ROLE_MOSI},
    {STM32_F373, 1, 5, 6, -1, 0, PIN_SPI, 3, ROLE_MOSI},
    {STM32_F373, 1, 6, 4, -1, 0, PIN_I2C, 1, ROLE_SCL},
    {STM32_F373, 1, 6, 7, -1, 0, PIN_USART, 1, ROLE_TX},
    {STM32_F373, 1, 7, 4, -1, 0, PIN_I2C, 1, ROLE_SDA},
    {STM32_F373, 1, 7, 7, -1, 0, PIN_USART, 1, ROLE_RX},
    {STM32_F373, 1, 8, 4, -1, 0, PIN_I2C, 1, ROLE_SCL},
    {STM32_F373, 1, 8, 5, -1, 0, PIN_SPI, 2, ROLE_SCK},
    {STM32_F373, 1, 8, 7, -1, 0, PIN_USART, 3, ROLE_TX},
    {STM32_F373, 1, 9, 4, -1, 0, PIN_I2C, 1, ROLE_SDA},
    {STM32_F373, 1, 9, 5, -1, 0, PIN_SPI, 2, ROLE_NSS},
    {STM32_F373, 1, 9, 7, -1, 0, PIN_USART, 3, ROLE_RX},
    {STM32_F373, 1, 10, 5, -1, 0, PIN_SPI, 2, ROLE_SCK},
    {STM32_F373, 1, 10, 7, -1, 0, PIN_USART, 3, ROLE_TX},
    {STM32_F373, 1, 14, 5, -1, 0, PIN_SPI, 2, ROLE_MCK},
    {STM32_F373, 1, 14, 5, -1, 0, PIN_SPI, 2, ROLE_MISO},
    {STM32_F373, 1, 15, 5, -1, 0, PIN_SPI, 2, ROLE_MOSI},
    {STM32_F373, 2, 2, 5, -1, 0, PIN_SPI, 2, ROLE_MCK},
    {STM32_F373, 2, 2, 5, -1, 0, PIN_SPI, 2, ROLE_MISO},
    {STM32_F373, 2, 3, 5, -1, 0, PIN_SPI, 2, ROLE_MOSI},
    {STM32_F373, 2, 4, 7, -1, 0, PIN_USART, 1, ROLE_TX},
    {STM32_F373, 2, 5, 7, -1, 0, PIN_USART, 1, ROLE_RX},
    {STM32_F373, 2, 6, 5, -1, 0, PIN_SPI, 1, ROLE_NSS},
    {STM32_F373, 2, 7, 5, -1, 0, PIN_SPI, 1, ROLE_SCK},
    {STM32_F373, 2, 8, 5, -1, 0, PIN_SPI, 1, ROLE_MCK},
    {STM32_F373, 2, 8, 5, -1, 0, PIN_SPI, 1, ROLE_MISO},
    {STM32_F373, 2, 9, 5, -1, 0, PIN_SPI, 1, ROLE_MOSI},
    {STM32_F373, 2, 10, 6, -1, 0, PIN_SPI, 3, ROLE_SCK},
    {STM32_F373, 2, 10, 7, -1, 0, PIN_USART, 3, ROLE_TX},
    {STM32_F373, 2, 11, 6, -1, 0, PIN_SPI, 3, ROLE_MCK},
    {STM32_F373, 2, 11, 6, -1, 0, PIN_SPI, 3, ROLE_MISO},
    {STM32_F373, 2, 11, 7, -1, 0, PIN_USART, 3, ROLE_RX},
    {STM32_F373, 2, 12, 6, -1, 0, PIN_SPI, 3, ROLE_MOSI},
    {STM32_F373, 3, 8, 5, -1, 0, PIN_SPI, 2, ROLE_SCK},
    {STM32_F373, 3, 8, 7, -1, 0, PIN_USART, 3, ROLE_TX},
    {STM32_F373, 5, 6, 4, -1, 0, PIN_I2C, 2, ROLE_SCL},
    {STM32_F373, 5, 6, 5, -1, 0, PIN_SPI, 1, ROLE_MOSI},
    {STM32_F373, 5, 7, 4, -1, 0, PIN_I2C, 2, ROLE_SDA},
    {STM32_F405, 0, 1, 8, -1, 0, PIN_USART, 4, ROLE_RX},
    {STM32_F405, 0, 2, 7, -1, 0, PIN_USART, 2, ROLE_TX},
    {STM32_F405, 0, 3, 7, -1, 0, PIN_USART, 2, ROLE_RX},
    {STM32_F405, 0, 4, 5, -1, 0, PIN_SPI, 1, ROLE_NSS},
    {STM32_F405, 0, 4, 6, -1, 0, PIN_SPI, 3, ROLE_NSS},
    {STM32_F405, 0, 5, 5, -1, 0, PIN_SPI, 1, ROLE_SCK},
    {STM32_F405, 0, 6, 5, -1, 0, PIN_SPI, 1, ROLE_MISO},
    {STM32_F405, 0, 7, 5, -1, 0, PIN_SPI, 1, ROLE_MOSI},
    {STM32_F405, 0, 8, 4, -1, 0, PIN_I2C, 3, ROLE_SCL},
    {STM32_F405, 0, 9, 7, -1, 0, PIN_USART, 1, ROLE_TX},
    {STM32_F405, 0, 10, 7, -1, 0, PIN_USART, 1, ROLE_RX},
    {STM32_F405, 0, 15, 5, -1, 0, PIN_SPI, 1, ROLE_NSS},
    {STM32_F405, 0, 15, 6, -1, 0, PIN_SPI, 3, ROLE_NSS},
    {STM32_F405, 1, 3, 5, -1, 0, PIN_SPI, 1, ROLE_SCK},
    {STM32_F405, 1, 3, 6, -1, 0, PIN_SPI, 3, ROLE_SCK},
    {STM32_F405, 1, 4, 5, -1, 0, PIN_SPI, 1, ROLE_MISO},
    {STM32_F405, 1, 4, 7, -1, 0, PIN_SPI, 3, ROLE_EXTSD},
    {STM32_F405, 1, 4, 6, -1, 0, PIN_SPI, 3, ROLE_MISO},
    {STM32_F405, 1, 5, 5, -1, 0, PIN_SPI, 1, ROLE_MOSI},
    {STM32_F405, 1, 5, 6, -1, 0, PIN_SPI, 3, ROLE_MOSI},
    {STM32_F405, 1, 6, 4, -1, 0, PIN_I2C, 1, ROLE_SCL},
    {STM32_F405, 1, 6, 7, -1, 0, PIN_USART, 1, ROLE_TX},
    {STM32_F405, 1, 7, 4, -1, 0, PIN_I2C, 1, ROLE_SDA},
    {STM32_F405, 1, 7, 7, -1, 0, PIN_USART, 1, ROLE_RX},
    {STM32_F405, 1, 8, 4, -1, 0, PIN_I2C, 1, ROLE_SCL},
    {STM32_F405, 1, 9, 4, -1, 0, PIN_I2C, 1, ROLE_SDA},
    {STM32_F405, 1, 9, 5, -1, 0, PIN_SPI, 2, ROLE_NSS},
    {STM32_F405, 1, 10, 4, -1, 0, PIN_I2C, 2, ROLE_SCL},
    {STM32_F405, 1, 10, 5, -1, 0, PIN_SPI, 2, ROLE_SCK},
    {STM32_F405, 1, 10, 7, -1, 0, PIN_USART, 3, ROLE_TX},
    {STM32_F405, 1, 11, 4, -1, 0, PIN_I2C, 2, ROLE_SDA},
    {STM32_F405, 1, 11, 7, -1, 0, PIN_USART, 3, ROLE_RX},
    {STM32_F405, 1, 12, 5, -1, 0, PIN_SPI, 2, ROLE_NSS},
    {STM32_F405, 1, 13, 5, -1, 0, PIN_SPI, 2, ROLE_SCK},
    {STM32_F405, 1, 14, 6, -1, 0, PIN_SPI, 2, ROLE_EXTSD},
    {STM32_F405, 1, 14, 5, -1, 0, PIN_SPI, 2, ROLE_MISO},
    {STM32_F405, 1, 15, 5, -1, 0, PIN_SPI, 2, ROLE_MOSI},
    {STM32_F405, 2, 2, 6, -1, 0, PIN_SPI, 2, ROLE_EXTSD},
    {STM32_F405, 2, 2, 5, -1, 0, PIN_SPI, 2, ROLE_MISO},
    {STM32_F405, 2, 3, 5, -1, 0, PIN_SPI, 2, ROLE_MOSI},
    {STM32_F405, 2, 6, 5, -1, 0, PIN_SPI, 2, ROLE_MCK},
    {STM32_F405, 2, 6, 8, -1, 0, PIN_USART, 6, ROLE_TX},
    {STM32_F405, 2, 7, 6, -1, 0, PIN_SPI, 3, ROLE_MCK},
    {STM32_F405, 2, 7, 8, -1, 0, PIN_USART, 6, ROLE_RX},
    {STM32_F405, 2, 9, 4, -1, 0, PIN_I2C, 3, ROLE_SDA},
    {STM32_F405, 2, 10, 6, -1, 0, PIN_SPI, 3, ROLE_SCK},
    {STM32_F405, 2, 10, 7, -1, 0, PIN_USART, 3, ROLE_TX},
    {STM32_F405, 2, 10, 8, -1, 0, PIN_USART, 4, ROLE_TX},
    {STM32_F405, 2, 11, 5, -1, 0, PIN_SPI, 3, ROLE_EXTSD},
    {STM32_F405, 2, 11, 6, -1, 0, PIN_SPI, 3, ROLE_MISO},
    {STM32_F405, 2, 11, 7, -1, 0, PIN_USART, 3, ROLE_RX},
    {STM32_F405, 2, 11, 8, -1, 0, PIN_USART, 4, ROLE_RX},
    {STM32_F405, 2, 12, 6, -1, 0, PIN_SPI, 3, ROLE_MOSI},
    {STM32_F405, 2, 12, 8, -1, 0, PIN_USART, 5, ROLE_TX},
    {STM32_F405, 3, 2, 8, -1, 0, PIN_USART, 5, ROLE_RX},
